## components/koios_tee/Kconfig.projbuild
```kconfig
menu "Koios TEE (ESP32-S3)"
    depends on IDF_TARGET_ESP32S3

    config KOIOS_TEE_ENABLED
        bool "Enable Koios TEE"
        default y
        help
            Enable Koios TEE (Trusted Execution Environment).
            TEE runs in RTC FAST memory (8KB at 0x600FE000).

    config KOIOS_TEE_EXCLUDE_RTC_FAST
        bool "Exclude RTC FAST from app heap"
        default y
        depends on KOIOS_TEE_ENABLED
        help
            When enabled, RTC FAST memory is reserved for TEE and
            not added to the app's heap. This prevents the app from
            overwriting TEE code.

endmenu
```

## components/koios_tee_client/Kconfig.projbuild
```kconfig
menu "Koios TEE Client (ESP32-S3)"
    depends on IDF_TARGET_ESP32S3

    config KOIOS_TEE_CLIENT_ENABLED
        bool "Enable Koios TEE Client"
        default y
        help
            Enable Koios TEE Client for calling TEE services from the app.
            Requires TEE to be initialized by the bootloader.

    config KOIOS_TEE_EXCLUDE_RTC_FAST
        bool "Exclude RTC FAST from app heap"
        default y
        depends on KOIOS_TEE_CLIENT_ENABLED
        help
            When enabled, RTC FAST memory (0x600FE000-0x60100000) is reserved
            for TEE and not added to the app's heap. This prevents the app
            from overwriting TEE code and shared memory.

endmenu
```

## components/sand_table/Kconfig.projbuild
```kconfig
menu "Polar Robot Motion System"

menu "TMC Stepper Configuration"
    config ROBOT_TMC_UART_PORT
        int "TMC UART Port"
        default 1

    config ROBOT_TMC_UART_TX_PIN
        int "TMC UART TX Pin"
        default 12

    config ROBOT_TMC_UART_RX_PIN
        int "TMC UART RX Pin"
        default 13

    config ROBOT_TMC_BAUD_RATE
        int "TMC UART Baud Rate"
        default 115200

    config ROBOT_THETA_TMC_ADDR
        int "Theta TMC Address"
        default 2

    config ROBOT_RHO_TMC_ADDR
        int "Rho TMC Address"
        default 0

    config ROBOT_THETA_STEP_PIN
        int "Theta Step Pin"
        default 39

    config ROBOT_THETA_DIR_PIN
        int "Theta Direction Pin"
        default 40

    config ROBOT_RHO_STEP_PIN
        int "Rho Step Pin"
        default 11

    config ROBOT_RHO_DIR_PIN
        int "Rho Direction Pin"
        default 10

    config ROBOT_COMMON_ENABLE_PIN
        int "Common Enable Pin"
        default 21

    config ROBOT_RHO_STALLGUARD_DIAG_PIN
        int "Rho StallGuard Diag Pin"
        default 14

    config ROBOT_THETA_STALLGUARD_DIAG_PIN
        int "Theta StallGuard Diag Pin"
        default 2
endmenu

menu "Theta Axis Hardware"
    config ROBOT_THETA_INVERT_DIRECTION
        bool "Invert Theta Direction"
        default n

    config ROBOT_THETA_HAS_ENDSTOP
        bool "Theta Has Endstop"
        default y

    menu "Theta Endstop Configuration"
        depends on ROBOT_THETA_HAS_ENDSTOP

        config ROBOT_THETA_ENDSTOP_PIN
            int "Theta Endstop Pin"
            default 17

        config ROBOT_THETA_ENDSTOP_INVERT
            bool "Invert Endstop Logic"
            default n

        config ROBOT_THETA_ENDSTOP_PULLUP
            bool "Enable Pullup"
            default y
    endmenu
endmenu

menu "Rho Axis Hardware"
    config ROBOT_RHO_INVERT_DIRECTION
        bool "Invert Rho Direction"
        default n
endmenu

# Note: Motion parameters (steps/rev, gear ratio, motor current, stallguard threshold,
# velocities, acceleration, pinion diameter) are now stored in NVS and configured
# via the ConfigManager preset system. See config_manager.h and presets.h.

endmenu
```

## main/Kconfig.projbuild
```kconfig
menu "LED Configuration"

config LED_PIN
    int "LED Pin"
    default 35
    help
        GPIO pin number for the LED strip data line.

# Note: LED count and type (RGB/RGBW) are now stored in NVS and configured
# via the ConfigManager preset system. See config_manager.h and presets.h.
config MBEDTLS_PK_RSA_ALT_SUPPORT
    bool
    default y

endmenu

menu "SD Card Configuration"

config SD_PIN_CLK
    int "SD CLK Pin"
    default 5
    help
        GPIO pin for the SD/MMC CLK line.

config SD_PIN_CMD
    int "SD CMD Pin"
    default 6
    help
        GPIO pin for the SD/MMC CMD line.

config SD_PIN_D0
    int "SD D0 Pin"
    default 4
    help
        GPIO pin for the SD/MMC DAT0 line.

config SD_PIN_D1
    int "SD D1 Pin"
    default 2
    help
        GPIO pin for the SD/MMC DAT1 line.

config SD_PIN_D2
    int "SD D2 Pin"
    default 8
    help
        GPIO pin for the SD/MMC DAT2 line.

config SD_PIN_D3
    int "SD D3 Pin"
    default 7
    help
        GPIO pin for the SD/MMC DAT3 line.

config SD_PIN_CD
    int "SD Card Detect Pin"
    default 1
    help
        GPIO pin for the SD card-detect (CD) line.

endmenu
```
