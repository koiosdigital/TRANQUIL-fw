## main/RobotMotion/Kconfig.projbuild
```kconfig
menu "Polar Robot Motion System"
    
    config ROBOT_MOTION_ENABLE
        bool "Enable Polar Robot Motion System"
        default y
        help
            Enable the 2-axis polar robot motion system for sand table control.

    menu "Robot Geometry"
        depends on ROBOT_MOTION_ENABLE

        config ROBOT_ARM_LENGTH_1
            int "Upper Arm Length (mm)"
            default 100
            range 10 500
            help
                Length of the upper arm segment in millimeters

        config ROBOT_ARM_LENGTH_2
            int "Lower Arm Length (mm)"
            default 100
            range 10 500
            help
                Length of the lower arm segment in millimeters

    endmenu

    menu "TMC Stepper Configuration"
        depends on ROBOT_MOTION_ENABLE

        config ROBOT_TMC_UART_PORT
            int "TMC UART Port"
            default 1
            range 0 2
            help
                UART port number for TMC stepper communication (0, 1, or 2)

        config ROBOT_TMC_UART_TX_PIN
            int "TMC UART TX Pin"
            default 17
            range 0 48
            help
                GPIO pin for TMC UART transmission

        config ROBOT_TMC_UART_RX_PIN
            int "TMC UART RX Pin"
            default 16
            range 0 48
            help
                GPIO pin for TMC UART reception

        config ROBOT_TMC_BAUD_RATE
            int "TMC UART Baud Rate"
            default 115200
            help
                Communication baud rate for TMC steppers

        config ROBOT_THETA_TMC_ADDR
            int "Theta Motor TMC Address"
            default 0
            range 0 3
            help
                UART address for theta (rotation) motor TMC driver

        config ROBOT_RHO_TMC_ADDR
            int "Rho Motor TMC Address"
            default 1
            range 0 3
            help
                UART address for rho (radial) motor TMC driver

        config ROBOT_THETA_STEP_PIN
            int "Theta Step Pin"
            default 18
            range 0 48
            help
                GPIO pin for theta motor step signal

        config ROBOT_THETA_DIR_PIN
            int "Theta Direction Pin"
            default 19
            range 0 48
            help
                GPIO pin for theta motor direction signal

        config ROBOT_RHO_STEP_PIN
            int "Rho Step Pin"
            default 20
            range 0 48
            help
                GPIO pin for rho motor step signal

        config ROBOT_RHO_DIR_PIN
            int "Rho Direction Pin"
            default 21
            range 0 48
            help
                GPIO pin for rho motor direction signal

        config ROBOT_COMMON_ENABLE_PIN
            int "Common Motor Enable Pin"
            default 22
            range 0 48
            help
                GPIO pin for common enable signal (active low - pulled low when motors are running)

        config ROBOT_STALLGUARD_DIAG_PIN
            int "StallGuard Diagnostic Pin"
            default 23
            range 0 48
            help
                GPIO pin for StallGuard diagnostic signal from TMC drivers

    endmenu

    menu "Theta Axis Configuration"
        depends on ROBOT_MOTION_ENABLE

        config ROBOT_THETA_MAX_SPEED
            int "Theta Maximum Speed (RPM)"
            default 60
            range 1 300
            help
                Maximum rotational speed for theta axis in RPM

        config ROBOT_THETA_MAX_ACCEL
            int "Theta Maximum Acceleration (RPM/s)"
            default 120
            range 10 1000
            help
                Maximum acceleration for theta axis in RPM per second

        config ROBOT_THETA_STEPS_PER_ROT
            int "Theta Steps per Motor Rotation (full steps)"
            default 200
            range 200 3200
            help
                Number of full motor steps for one complete motor rotation (without microstepping)

        config ROBOT_THETA_GEAR_RATIO
            int "Theta Gear Ratio (Motor:Drive ratio x100)"
            default 500
            range 100 2000
            help
                Gear ratio from motor to drive gear, multiplied by 100 (e.g., 5:1 ratio = 500)

        config ROBOT_THETA_MOTOR_CURRENT
            int "Theta Motor Current (mA)"
            default 800
            range 100 2000
            help
                Run current for theta motor in milliamps

        config ROBOT_THETA_ENDSTOP_PIN
            int "Theta Endstop GPIO Pin"
            default 4
            range 0 48
            help
                GPIO pin for theta axis endstop switch

        config ROBOT_THETA_ENDSTOP_INVERT
            bool "Invert Theta Endstop Logic"
            default n
            help
                Invert the logic of theta endstop (normally open vs normally closed)

    endmenu

    menu "Rho Axis Configuration"
        depends on ROBOT_MOTION_ENABLE

        config ROBOT_RHO_MAX_SPEED
            int "Rho Maximum Speed (mm/min)"
            default 600
            range 10 3000
            help
                Maximum linear speed for rho axis in mm per minute

        config ROBOT_RHO_MAX_ACCEL
            int "Rho Maximum Acceleration (mm/min²)"
            default 1200
            range 100 5000
            help
                Maximum acceleration for rho axis in mm per minute squared

        config ROBOT_RHO_STEPS_PER_MM
            int "Rho Steps per Millimeter (full steps)"
            default 5
            range 1 100
            help
                Number of full motor steps per millimeter of linear movement (without microstepping)

        config ROBOT_RHO_STEPS_PER_ROT
            int "Rho Steps per Motor Rotation (full steps)"
            default 200
            range 200 3200
            help
                Number of full motor steps for one complete motor rotation (without microstepping)

        config ROBOT_RHO_MOTOR_CURRENT
            int "Rho Motor Current (mA)"
            default 600
            range 100 2000
            help
                Run current for rho motor in milliamps

        config ROBOT_RHO_MIN_RADIUS
            int "Rho Minimum Radius (mm)"
            default 10
            range 0 100
            help
                Minimum allowed radius for rho axis movement

        config ROBOT_RHO_MAX_RADIUS
            int "Rho Maximum Radius (mm)"
            default 150
            range 50 300
            help
                Maximum allowed radius for rho axis movement

    endmenu

    menu "StallGuard Configuration"
        depends on ROBOT_MOTION_ENABLE

        config ROBOT_RHO_STALLGUARD_THRESHOLD
            int "Rho StallGuard Threshold"
            default 128
            range 0 255
            help
                StallGuard sensitivity threshold for rho axis homing (higher = less sensitive)
    endmenu

    menu "Motion Planning"
        depends on ROBOT_MOTION_ENABLE

        config ROBOT_MOTION_TASK_PRIORITY
            int "Motion Task Priority"
            default 5
            range 1 25
            help
                FreeRTOS task priority for the motion control task (higher = more priority)

        config ROBOT_MOTION_TASK_STACK_SIZE
            int "Motion Task Stack Size"
            default 8192
            range 4096 16384
            help
                Stack size for the motion control task in bytes

        config ROBOT_MOTION_TASK_INTERVAL_MS
            int "Motion Task Service Interval (ms)"
            default 10
            range 1 100
            help
                How often the motion task runs in milliseconds (lower = more responsive)

        config ROBOT_MOTION_PIPELINE_LENGTH
            int "Motion Pipeline Length"
            default 100
            range 10 500
            help
                Number of motion blocks that can be queued for smooth motion

        config ROBOT_JUNCTION_DEVIATION
            int "Junction Deviation (micrometers)"
            default 50
            range 1 1000
            help
                Maximum deviation allowed at path junctions in micrometers

        config ROBOT_BLOCK_DISTANCE_MM
            int "Block Distance (micrometers)"
            default 0
            range 0 10000
            help
                Minimum distance for motion planning blocks in micrometers (0 = auto)

    endmenu

endmenu
```

## main/stusb4500/Kconfig.projbuild
```kconfig
menu "STUSB4500 USB-C PD Controller"
    
    config STUSB4500_ENABLE
        bool "Enable STUSB4500 USB-C PD Controller"
        default y
        help
            Enable the STUSB4500 USB-C Power Delivery controller support.

    menu "I2C Configuration"
        depends on STUSB4500_ENABLE

        config STUSB4500_I2C_PORT
            int "I2C Port Number"
            default 0
            range 0 1
            help
                I2C port number for STUSB4500 communication (0 or 1)

        config STUSB4500_SDA_PIN
            int "I2C SDA Pin"
            default 21
            range 0 48
            help
                GPIO pin for I2C SDA (data) line

        config STUSB4500_SCL_PIN
            int "I2C SCL Pin"
            default 22
            range 0 48
            help
                GPIO pin for I2C SCL (clock) line

        config STUSB4500_I2C_ADDR
            hex "STUSB4500 I2C Address"
            default 0x28
            range 0x08 0x77
            help
                I2C slave address for the STUSB4500 chip (default 0x28)

        config STUSB4500_I2C_FREQ_HZ
            int "I2C Clock Frequency (Hz)"
            default 100000
            range 10000 400000
            help
                I2C clock frequency in Hz (100kHz recommended)

        config STUSB4500_I2C_TIMEOUT_MS
            int "I2C Transaction Timeout (ms)"
            default 1000
            range 100 5000
            help
                Timeout for I2C transactions in milliseconds

    endmenu

    menu "Power Delivery Configuration"
        depends on STUSB4500_ENABLE

        config STUSB4500_MONITOR_INTERVAL_MS
            int "Status Monitor Interval (ms)"
            default 100
            range 50 1000
            help
                How often to check negotiation status in milliseconds

        config STUSB4500_DEBUG_ENABLE
            bool "Enable Debug Logging"
            default n
            help
                Enable detailed debug logging for STUSB4500 operations

    endmenu

endmenu
```
