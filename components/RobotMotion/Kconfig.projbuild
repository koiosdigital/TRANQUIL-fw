## components/RobotMotion/Kconfig.projbuild
```kconfig
menu "Polar Robot Motion System"
    menu "TMC Stepper Configuration"
        config ROBOT_TMC_UART_PORT
            int "TMC UART Port"
            default 1
            range 0 2
            help
                UART port number for TMC stepper communication (0, 1, or 2)

        config ROBOT_TMC_UART_TX_PIN
            int "TMC UART TX Pin"
            default 17
            range 0 48
            help
                GPIO pin for TMC UART transmission

        config ROBOT_TMC_UART_RX_PIN
            int "TMC UART RX Pin"
            default 16
            range 0 48
            help
                GPIO pin for TMC UART reception

        config ROBOT_TMC_BAUD_RATE
            int "TMC UART Baud Rate"
            default 115200
            help
                Communication baud rate for TMC steppers

        config ROBOT_THETA_TMC_ADDR
            int "Theta Motor TMC Address"
            default 0
            range 0 3
            help
                UART address for theta (rotation) motor TMC driver

        config ROBOT_RHO_TMC_ADDR
            int "Rho Motor TMC Address"
            default 1
            range 0 3
            help
                UART address for rho (radial) motor TMC driver

        config ROBOT_THETA_STEP_PIN
            int "Theta Step Pin"
            default 18
            range 0 48
            help
                GPIO pin for theta motor step signal

        config ROBOT_THETA_DIR_PIN
            int "Theta Direction Pin"
            default 19
            range 0 48
            help
                GPIO pin for theta motor direction signal

        config ROBOT_RHO_STEP_PIN
            int "Rho Step Pin"
            default 20
            range 0 48
            help
                GPIO pin for rho motor step signal

        config ROBOT_RHO_DIR_PIN
            int "Rho Direction Pin"
            default 21
            range 0 48
            help
                GPIO pin for rho motor direction signal

        config ROBOT_COMMON_ENABLE_PIN
            int "Common Motor Enable Pin"
            default 22
            range 0 48
            help
                GPIO pin for common enable signal (active low - pulled low when motors are running)

        config ROBOT_RHO_STALLGUARD_DIAG_PIN
            int "Rho StallGuard Diagnostic Pin"
            default 23
            range 0 48
            help
                GPIO pin for StallGuard diagnostic signal from Rho driver

        config ROBOT_THETA_STALLGUARD_DIAG_PIN
            int "Theta StallGuard Diagnostic Pin"
            default 24
            range 0 48
            help
                GPIO pin for StallGuard diagnostic signal from Theta driver
    endmenu

    menu "Theta Axis Configuration"
        config ROBOT_THETA_MAX_SPEED
            int "Theta Maximum Speed (RPM)"
            default 15
            range 1 30
            help
                Maximum rotational speed for theta axis in RPM (post gearing)

        config ROBOT_THETA_MAX_ACCEL
            int "Theta Maximum Acceleration (RPM/s)"
            default 2
            range 1 100
            help
                Maximum acceleration for theta axis in RPM (post gearing)

        config ROBOT_THETA_STEPS_PER_ROT
            int "Theta Steps per Motor Rotation (full steps)"
            default 200
            range 200 400
            help
                Number of full motor steps for one complete motor rotation (without microstepping)

        config ROBOT_THETA_GEAR_RATIO
            int "Theta Gear Ratio (Motor:Drive ratio x100)"
            default 800
            range 100 2000
            help
                Gear ratio from motor to drive gear, multiplied by 100 (e.g., 5:1 ratio = 500)

        config ROBOT_THETA_MOTOR_CURRENT
            int "Theta Motor Current (mA)"
            default 800
            range 100 1200
            help
                Run current for theta motor in milliamps

        config ROBOT_THETA_INVERT_DIRECTION
            bool "Invert Theta Motor Direction"
            default n
            help
                Invert the direction signal for the theta motor (set if motor moves opposite to expected)

        config ROBOT_THETA_HAS_ENDSTOP
            bool "Theta Axis Has Endstop"
            default y
            help
                Enable if the theta axis has an endstop switch installed

        menu "Theta Endstop Configuration"
            depends on ROBOT_THETA_HAS_ENDSTOP

            config ROBOT_THETA_ENDSTOP_PIN
            int "Theta Endstop GPIO Pin"
            default 4
            range 0 48
            help
                GPIO pin for theta axis endstop switch

            config ROBOT_THETA_ENDSTOP_INVERT
            bool "Invert Theta Endstop Logic"
            default n
            help
                Invert the logic of theta endstop (normally open vs normally closed)

            config ROBOT_THETA_ENDSTOP_PULLUP
            bool "Enable Pull-Up for Theta Endstop"
            default y
            help
                Enable internal pull-up resistor for theta endstop pin
        endmenu

    endmenu

    menu "Rho Axis Configuration"
        config ROBOT_RHO_MAX_SPEED
            int "Rho Maximum Speed (mm/min)"
            default 600
            range 10 3000
            help
                Maximum linear speed for rho axis in mm per minute

        config ROBOT_RHO_MAX_ACCEL
            int "Rho Maximum Acceleration (mm/min²)"
            default 1200
            range 100 5000
            help
                Maximum acceleration for rho axis in mm/min ^2

        config ROBOT_RHO_STEPS_PER_MM
            int "Rho Steps per Millimeter (full steps)"
            default 5
            range 1 100
            help
                Number of full motor steps per millimeter of linear movement (without microstepping)

        config ROBOT_RHO_STEPS_PER_ROT
            int "Rho Steps per Motor Rotation (full steps)"
            default 200
            range 200 400
            help
                Number of full motor steps for one complete motor rotation (without microstepping)

        config ROBOT_RHO_MOTOR_CURRENT
            int "Rho Motor Current (mA)"
            default 600
            range 100 1200
            help
                Run current for rho motor in milliamps

        config ROBOT_RHO_MAX_RADIUS
            int "Rho Maximum Radius (mm)"
            default 150
            range 50 300
            help
                Maximum allowed radius for rho axis movement

        config ROBOT_RHO_INVERT_DIRECTION
            bool "Invert Rho Motor Direction"
            default n
            help
                Invert the direction signal for the rho motor (set if motor moves opposite to expected)
            
        menu "StallGuard Configuration"
            config ROBOT_RHO_STALLGUARD_THRESHOLD
                int "Rho StallGuard Threshold"
                default 200
                range 0 255
                help
                    StallGuard4 sensitivity threshold for rho axis homing (higher = less sensitive, typical range 150-255)
        endmenu
    endmenu
endmenu
```

## components/clock-app/Kconfig
```kconfig
# Component configuration for clock-app
menu "Clock App Component"

    config CLOCK_APP_AUTO_DOWNLOAD
        bool "Automatically download latest static files"
        default y
        help
            Automatically download the latest static_files.h from the clock-app repository
            during build time. If disabled, a fallback empty static files will be used.

    config CLOCK_APP_CACHE_TIMEOUT
        int "Cache timeout for downloads (hours)"
        depends on CLOCK_APP_AUTO_DOWNLOAD
        default 24
        range 1 168
        help
            How long to cache downloaded files before checking for updates.
            Set to a lower value for more frequent updates during development.

endmenu
```

## components/stusb4500/Kconfig.projbuild
```kconfig
menu "STUSB4500 USB-C PD Controller"
    menu "I2C Configuration"
        config STUSB4500_I2C_PORT
            int "I2C Port Number"
            default 0
            range 0 1
            help
                I2C port number for STUSB4500 communication (0 or 1)

        config STUSB4500_SDA_PIN
            int "I2C SDA Pin"
            default 21
            range 0 48
            help
                GPIO pin for I2C SDA (data) line

        config STUSB4500_SCL_PIN
            int "I2C SCL Pin"
            default 22
            range 0 48
            help
                GPIO pin for I2C SCL (clock) line

        config STUSB4500_I2C_ADDR
            hex "STUSB4500 I2C Address"
            default 0x28
            range 0x08 0x77
            help
                I2C slave address for the STUSB4500 chip (default 0x28)
    endmenu
endmenu
```
